## zephyr/Kconfig
```kconfig
# Yoshinori Kurimoto 03022025
# SPDX-License-Identifier: Apache-2.0

rsource "drivers/adc/Kconfig"
```

## zephyr/drivers/adc/Kconfig
```kconfig
# Yoshinori Kurimoto 03.02.2025
# SPDX-License-Identifier: Apache-2.0

if ADC

rsource "Kconfig.adc_stm32_custom"

endif
```
